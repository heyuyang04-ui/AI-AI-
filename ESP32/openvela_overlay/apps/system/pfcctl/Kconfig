## ESP32/openvela_overlay/apps/system/pfcctl/Kconfig
```kconfig
config SYSTEM_PFCCTL
	tristate "ESP32-S3-EYE PFC/LLC gateway client"
	default n
	depends on SERIAL_TERMIOS
	---help---
		Build the restricted pfcctl UART client used to read the STM32
		gateway and request a fail-safe stop. It never writes DSP PWM,
		protection thresholds, raw CAN frames, ARM tokens, or fault reset.

if SYSTEM_PFCCTL

config SYSTEM_PFCCTL_PROGNAME
	string "Program name"
	default "pfcctl"

config SYSTEM_PFCCTL_PRIORITY
	int "Task priority"
	default 100

config SYSTEM_PFCCTL_STACKSIZE
	int "Task stack size"
	default 4096

config SYSTEM_PFCCTL_DEVICE
	string "STM32 UART device"
	default "/dev/ttyS0"

config SYSTEM_PFCCTL_TIMEOUT_MS
	int "UART response timeout in milliseconds"
	range 100 10000
	default 1200

endif
```

## STM32/stm32f407zg-pfcllc/Kconfig
```kconfig
# SPDX-License-Identifier: Apache-2.0

if ARCH_BOARD_STM32F407ZG_PFCLLC

config STM32F407ZG_PFCLLC_CAN_STANDBY
	bool "Board controls an external CAN transceiver standby pin"
	default n
	help
	  Leave this disabled unless the board schematic confirms a GPIO-connected
	  STB/EN pin. PA11 and PA12 are always configured by the CAN1 driver.

endif
```

## STM32/stm32f407zg-pfcllc/configs/gateway/defconfig
```kconfig
# STM32F407ZGT6 PFC/LLC OpenVela gateway
CONFIG_ARCH="arm"
CONFIG_ARCH_BOARD="stm32f407zg-pfcllc"
CONFIG_ARCH_BOARD_STM32F407ZG_PFCLLC=y
CONFIG_ARCH_CHIP="stm32"
CONFIG_ARCH_CHIP_STM32=y
CONFIG_ARCH_CHIP_STM32F407ZG=y
CONFIG_ARCH_STACKDUMP=y
CONFIG_BOARD_LATE_INITIALIZE=y
CONFIG_BOARD_LOOPSPERMSEC=16717
CONFIG_BUILTIN=y
CONFIG_CAN_EXTID=y
CONFIG_FS_PROCFS=y
CONFIG_INIT_ENTRYPOINT="nsh_main"
CONFIG_INTELHEX_BINARY=y
CONFIG_LINE_MAX=128
CONFIG_NSH_BUILTIN_APPS=y
CONFIG_NSH_FILEIOSIZE=512
CONFIG_NSH_READLINE=y
CONFIG_PREALLOC_TIMERS=4
CONFIG_RAM_SIZE=114688
CONFIG_RAM_START=0x20000000
CONFIG_RAW_BINARY=y
CONFIG_RR_INTERVAL=200
CONFIG_SCHED_WAITPID=y
CONFIG_START_DAY=1
CONFIG_START_MONTH=1
CONFIG_START_YEAR=2026
CONFIG_STM32_CAN1=y
CONFIG_STM32_CAN1_BAUD=125000
CONFIG_STM32_CAN_TSEG1=5
CONFIG_STM32_CAN_TSEG2=2
CONFIG_STM32_JTAG_SW_ENABLE=y
CONFIG_STM32_PWR=y
CONFIG_STM32_USART1=y
CONFIG_STM32_USART6=y
CONFIG_SYSTEM_NSH=y
CONFIG_SYSTEM_VELA_GATEWAY=y
CONFIG_SYSTEM_VELA_GATEWAY_CAN_DEVPATH="/dev/can0"
CONFIG_SYSTEM_VELA_GATEWAY_UART_DEVPATH="/dev/ttyS1"
CONFIG_USART1_BAUD=115200
CONFIG_USART1_RXBUFSIZE=256
CONFIG_USART1_SERIAL_CONSOLE=y
CONFIG_USART1_TXBUFSIZE=256
CONFIG_USART6_BAUD=115200
CONFIG_USART6_RXBUFSIZE=512
CONFIG_USART6_TXBUFSIZE=512
```
